&mdss_mdp {
	dsi_boe_ft2389_amoled_169_cmd: qcom,mdss_dsi_ft2389_amoled_169_cmd {
		qcom,mdss-dsi-panel-name =
			"FT2389 1.69 amoled cmd mode";
		qcom,mdss-dsi-panel-type = "dsi_cmd_mode";
		qcom,mdss-dsi-panel-physical-type = "oled";
		qcom,mdss-dsi-virtual-channel-id = <0>;
		qcom,mdss-dsi-stream = <0>;
		qcom,mdss-dsi-bpp = <24>;
		qcom,mdss-dsi-color-order = "rgb_swap_rgb";
		qcom,mdss-dsi-underflow-color = <0xff>;
		qcom,mdss-dsi-border-color = <0>;

		qcom,dsi-ctrl-num = <0>;
		qcom,dsi-phy-num = <0>;

		qcom,mdss-dsi-traffic-mode = "burst_mode";
		qcom,mdss-dsi-lane-map = "lane_map_0123";
		qcom,mdss-dsi-bllp-eof-power-mode;
		qcom,mdss-dsi-bllp-power-mode;
		qcom,mdss-dsi-lane-0-state;
		qcom,mdss-dsi-dma-trigger = "trigger_sw";
		qcom,mdss-dsi-mdp-trigger = "none";
		qcom,mdss-dsi-reset-sequence = <0 8>, <1 8>;
		qcom,mdss-dsi-te-pin-select = <1>;
		qcom,mdss-dsi-te-dcs-command = <1>;
		qcom,mdss-dsi-te-check-enable;
		qcom,mdss-dsi-te-using-te-pin;
		qcom,mdss-dsi-t-clk-post = <0x09>;
		qcom,mdss-dsi-t-clk-pre = <0x0D>;

		qcom,mdss-dsi-bl-pmic-control-type = "bl_ctrl_dcs";
		qcom,mdss-dsi-bl-min-level = <1>;
		qcom,mdss-dsi-bl-max-level = <255>;

		qcom,mdss-dsi-display-timings {
			timing@0 {
				qcom,mdss-dsi-panel-framerate = <60>;
				qcom,mdss-dsi-panel-width = <378>;
				qcom,mdss-dsi-panel-height = <496>;
				qcom,mdss-dsi-h-front-porch = <22>;
				qcom,mdss-dsi-h-back-porch = <20>;
				qcom,mdss-dsi-h-pulse-width = <4>;
				qcom,mdss-dsi-h-sync-skew = <0>;
				qcom,mdss-dsi-v-back-porch = <24>;
				qcom,mdss-dsi-v-front-porch = <20>;
				qcom,mdss-dsi-v-pulse-width = <4>;
				qcom,mdss-dsi-h-left-border = <0>;
				qcom,mdss-dsi-h-right-border = <0>;
				qcom,mdss-dsi-v-top-border = <0>;
				qcom,mdss-dsi-v-bottom-border = <0>;

				qcom,mdss-dsi-on-command = [
					15 01 00 00 00 00 02 00 00
					39 01 00 00 00 00 04 FF 23 89 01
					15 01 00 00 00 00 02 00 80
					39 01 00 00 00 00 03 FF 23 89   /*enable cmd2*/
					15 01 00 00 00 00 02 00 D0
					15 01 00 00 00 00 02 C0 40     /*AOD TE 60hz*/
					15 01 00 00 00 00 02 00 B0     /*set DSTB timeout start*/
					15 01 00 00 00 00 02 B3 01
					15 01 00 00 00 00 02 00 B1
					15 01 00 00 00 00 02 B3 FF     /*set DSTB timeout end*/
					15 01 00 00 00 00 02 00 00
					39 01 00 00 00 00 04 FF 00 00 00
					15 01 00 00 00 00 02 00 80
					39 01 00 00 00 00 03 FF 00 00  /*disable cmd2*/
					15 01 00 00 00 00 02 35 00     /*set TE*/
					05 01 00 00 30 00 01 11        /*sleep out*/
					05 01 00 00 00 00 01 29        /*display on*/
				];
				qcom,mdss-dsi-off-command = [
					05 01 00 00 00 00 02 28 00     /*display off*/
					05 01 00 00 37 00 02 10 00      /*sleep in*/
					15 01 00 00 00 00 02 00 00
					39 01 00 00 00 00 04 FF 23 89 01
					15 01 00 00 00 00 02 00 80
					39 01 00 00 00 00 03 FF 23 89   /*enable cmd2*/
					15 01 00 00 00 00 02 00 00
					39 01 00 00 00 00 05 F7 5A A5 95 27  /*enter deep standby*/
					15 01 00 00 00 00 02 00 00
					39 01 00 00 00 00 04 FF 00 00 00
					15 01 00 00 00 00 02 00 80
					39 01 00 00 00 00 03 FF 00 00   /*disable cmd2*/
				];
				qcom,mdss-dsi-on-command-state = "dsi_lp_mode";
				qcom,mdss-dsi-off-command-state = "dsi_hs_mode";

				qcom,mdss-dsi-lp1-command = [
					15 01 00 00 00 00 02 26 01  /*switch gamma*/
					15 01 00 00 00 00 02 39 00  /*Idle Mode on*/
					15 01 00 00 00 00 02 51 80
					15 01 00 00 00 00 02 69 D0  /*enter 1hz*/
				];
				qcom,mdss-dsi-nolp-command = [
					15 01 00 00 00 00 02 69 00  /*exit 1hz*/
					15 01 00 00 00 00 02 38 00  /*Idle Mode Off*/
					15 01 00 00 00 00 02 26 00
				];
				qcom,mdss-dsi-lp1-command-state = "dsi_hs_mode";
				qcom,mdss-dsi-nolp-command-state = "dsi_hs_mode";

				qcom,mdss-dsi-hbm-on-command = [
					39 00 00 00 00 00 03 51 7F 01
					15 01 00 00 00 00 02 53 C0  /*HBM enter*/
				];
				qcom,mdss-dsi-hbm-off-command = [
					39 00 00 00 00 00 03 51 FF 00
					15 01 00 00 00 00 02 53 00  /*HBM exit*/
				];
				qcom,mdss-dsi-hbm-on-command-state = "dsi_hs_mode";
				qcom,mdss-dsi-hbm-off-command-state = "dsi_hs_mode";
				qcom,mdss-dsi-data-dimming-on-command = [
					15 01 00 00 00 00 02 00 00
					39 01 00 00 00 00 04 FF 23 89 01
					15 01 00 00 00 00 02 00 80
					39 01 00 00 00 00 03 FF 23 89   /*enable cmd2*/
					15 01 00 00 00 00 02 00 51
					15 01 00 00 00 00 02 C8 E6     /*enable dimming*/
					15 01 00 00 00 00 02 00 00
					39 01 00 00 00 00 04 FF 00 00 00
					15 01 00 00 00 00 02 00 80
					39 01 00 00 00 00 03 FF 00 00   /*disable cmd2*/
				];
				qcom,mdss-dsi-data-dimming-off-command = [
					15 01 00 00 00 00 02 00 00
					39 01 00 00 00 00 04 FF 23 89 01
					15 01 00 00 00 00 02 00 80
					39 01 00 00 00 00 03 FF 23 89   /*enable cmd2*/
					15 01 00 00 00 00 02 00 51
					15 01 00 00 00 00 02 C8 00     /*disable dimming*/
					15 01 00 00 00 00 02 00 00
					39 01 00 00 00 00 04 FF 00 00 00
					15 01 00 00 00 00 02 00 80
					39 01 00 00 00 00 03 FF 00 00   /*disable cmd2*/
				];
				qcom,mdss-dsi-data-dimming-on-command-state = "dsi_lp_mode";
				qcom,mdss-dsi-data-dimming-off-command-state = "dsi_hs_mode";
				qcom,mdss-dsi-lock-command = [
					15 01 00 00 00 00 02 00 00
					39 01 00 00 00 00 04 FF 23 89 01
					15 01 00 00 00 00 02 00 80
					39 01 00 00 00 00 03 FF 23 89   /*enable cmd2*/
					15 01 00 00 00 00 02 00 00
					39 01 00 00 00 00 03 99 00 00  /*CMD1 lock*/
					15 01 00 00 00 00 02 00 00
					39 01 00 00 00 00 04 FF 00 00 00
					15 01 00 00 00 00 02 00 80
					39 01 00 00 00 00 03 FF 00 00   /*disable cmd2*/
				];
				qcom,mdss-dsi-unlock-command = [
					15 01 00 00 00 00 02 00 00
					39 01 00 00 00 00 04 FF 23 89 01
					15 01 00 00 00 00 02 00 80
					39 01 00 00 00 00 03 FF 23 89   /*enable cmd2*/
					15 01 00 00 00 00 02 00 00
					39 01 00 00 00 00 03 99 95 27  /*CMD1 unlock*/
					15 01 00 00 00 00 02 00 00
					39 01 00 00 00 00 04 FF 00 00 00
					15 01 00 00 00 00 02 00 80
					39 01 00 00 00 00 03 FF 00 00   /*disable cmd2*/
				];
				qcom,mdss-dsi-lock-command-state = "dsi_hs_mode";
				qcom,mdss-dsi-unlock-command-state = "dsi_hs_mode";
			};
		};
	};
};
