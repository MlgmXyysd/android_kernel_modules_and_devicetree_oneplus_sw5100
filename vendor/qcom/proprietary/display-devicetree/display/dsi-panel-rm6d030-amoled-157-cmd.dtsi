&mdss_mdp {
	dsi_boe_rm6d030_amoled_157_cmd: qcom,mdss_dsi_rm6d030_amoled_157_cmd {
		qcom,mdss-dsi-panel-name =
			"RM6D030 1.57 amoled cmd mode";
		qcom,mdss-dsi-panel-type = "dsi_cmd_mode";
		qcom,mdss-dsi-panel-physical-type = "oled";
		qcom,mdss-dsi-virtual-channel-id = <0>;
		qcom,mdss-dsi-stream = <0>;
		qcom,mdss-dsi-bpp = <24>;
		qcom,mdss-dsi-color-order = "rgb_swap_rgb";
		qcom,mdss-dsi-underflow-color = <0xff>;
		qcom,mdss-dsi-border-color = <0>;

		qcom,dsi-ctrl-num = <0>;
		qcom,dsi-phy-num = <0>;

		qcom,mdss-dsi-traffic-mode = "burst_mode";
		qcom,mdss-dsi-lane-map = "lane_map_0123";
		qcom,mdss-dsi-bllp-eof-power-mode;
		qcom,mdss-dsi-bllp-power-mode;
		qcom,mdss-dsi-lane-0-state;
		qcom,mdss-dsi-dma-trigger = "trigger_sw";
		qcom,mdss-dsi-mdp-trigger = "none";
		qcom,mdss-dsi-reset-sequence = <0 25>, <1 25>;
		qcom,mdss-dsi-te-pin-select = <1>;
		qcom,mdss-dsi-te-dcs-command = <1>;
		qcom,mdss-dsi-te-check-enable;
		qcom,mdss-dsi-te-using-te-pin;
		qcom,mdss-dsi-t-clk-post = <0x07>;
		qcom,mdss-dsi-t-clk-pre = <0x0A>;

		qcom,mdss-dsi-bl-pmic-control-type = "bl_ctrl_dcs";
		qcom,mdss-dsi-bl-min-level = <1>;
		qcom,mdss-dsi-bl-max-level = <255>;

		qcom,mdss-dsi-display-timings {
			timing@0 {
				qcom,mdss-dsi-panel-framerate = <60>;
				qcom,mdss-dsi-panel-width = <324>;
				qcom,mdss-dsi-panel-height = <394>;
				qcom,mdss-dsi-h-front-porch = <40>;
				qcom,mdss-dsi-h-back-porch = <20>;
				qcom,mdss-dsi-h-pulse-width = <2>;
				qcom,mdss-dsi-h-sync-skew = <0>;
				qcom,mdss-dsi-v-back-porch = <16>;
				qcom,mdss-dsi-v-front-porch = <16>;
				qcom,mdss-dsi-v-pulse-width = <2>;
				qcom,mdss-dsi-h-left-border = <0>;
				qcom,mdss-dsi-h-right-border = <0>;
				qcom,mdss-dsi-v-top-border = <0>;
				qcom,mdss-dsi-v-bottom-border = <0>;

				qcom,mdss-dsi-on-command = [
					15 01 00 00 00 00 02 fe 00
					39 00 00 00 00 00 05 2a 00 12 01 55
					39 01 00 00 00 00 05 2b 00 00 01 89
					39 00 00 00 00 00 05 31 00 13 01 54
					39 01 00 00 00 00 05 30 00 01 01 88
					15 01 00 00 00 00 02 12 00
					15 01 00 00 00 00 02 35 00
					15 01 00 00 00 00 02 53 20
					05 01 00 00 50 00 01 11
					05 01 00 00 00 00 01 29
				];
				qcom,mdss-dsi-off-command = [
					05 01 00 00 14 00 02 28 00
					05 01 00 00 78 00 02 10 00
					15 01 00 00 00 00 02 4F 01];
				qcom,mdss-dsi-on-command-state = "dsi_lp_mode";
				qcom,mdss-dsi-off-command-state = "dsi_hs_mode";

				qcom,mdss-dsi-lp2-command = [
					15 01 00 00 00 00 02 fe 00
					15 01 00 00 00 00 02 39 00  /*Idle Mode on*/
				];
				qcom,mdss-dsi-nolp-command = [
					15 01 00 00 00 00 02 fe 00
					15 01 00 00 00 00 02 38 00  /*Idle Mode Off*/
				];
				qcom,mdss-dsi-lp2-command-state = "dsi_hs_mode";
				qcom,mdss-dsi-nolp-command-state = "dsi_hs_mode";

				qcom,mdss-dsi-hbm-on-command = [
					15 01 00 00 00 00 02 66 02 /*HBM ON*/
					15 01 00 00 00 00 02 63 FF
				];
				qcom,mdss-dsi-hbm-off-command = [
					15 01 00 00 00 00 02 66 00 /*HBM OFF*/
				];
				qcom,mdss-dsi-hbm-on-command-state = "dsi_hs_mode";
				qcom,mdss-dsi-hbm-off-command-state = "dsi_hs_mode";
			};
		};
	};
};
