/dts-v1/;

#include "qcs410.dtsi"
#include "prairie-410-iot-idp.dtsi"

/ {
	model = "Qualcomm Technologies, Inc. QCS410 PM6150 IDP";
	compatible = "qcom,qcs410-idp", "qcom,qcs410", "qcom,idp";
	qcom,board-id = <34 0>;
};

