/dts-v1/;

#include "qcs610.dtsi"
#include "qcs610-ipc.dtsi"

/ {
	model = "Qualcomm Technologies, Inc. QCS610 IPC";
	compatible = "qcom,qcs610-iot", "qcom,qcs610", "qcom,iot";
	qcom,board-id = <32 1>;
};
