/dts-v1/;

#include "sa415m-mtp.dtsi"
#include "sa415m-v2.dtsi"

/ {
	model = "Qualcomm Technologies, Inc. SA415M MTP V2";
	compatible = "qcom,sa415m-ccard",
			"qcom,sa415m", "qcom,ccard";
	qcom,board-id = <8 0x106>;
};

