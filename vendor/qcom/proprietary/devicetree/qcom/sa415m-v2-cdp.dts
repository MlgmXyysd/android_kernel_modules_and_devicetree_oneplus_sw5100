/dts-v1/;

#include "sa415m-cdp.dtsi"
#include "sa415m-v2.dtsi"

/ {
	model = "Qualcomm Technologies, Inc. SA415M CDP V2";
	compatible = "qcom,sa415m-cdp",
			"qcom,sa415m", "qcom,cdp";
	qcom,board-id = <1 0x104>;
};

