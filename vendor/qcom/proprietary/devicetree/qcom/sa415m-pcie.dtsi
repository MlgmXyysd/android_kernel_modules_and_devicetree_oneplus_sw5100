#include <dt-bindings/clock/qcom,gcc-sdxpoorwills.h>

&soc {
	pcie0: qcom,pcie@1c00000 {
		compatible = "qcom,pci-msm";
		cell-index = <0>;

		reg = <0x01c00000 0x2000>,
		      <0x01c02000 0x1000>,
		      <0x40000000 0xf1d>,
		      <0x40000f20 0xa8>,
		      <0x40001000 0x1000>,
		      <0x40100000 0x100000>,
		      <0x01fce008 0x4>;

		reg-names = "parf", "phy", "dm_core", "elbi", "iatu",
				"conf", "tcsr";

		#address-cells = <3>;
		#size-cells = <2>;
		ranges = <0x01000000 0x0 0x40200000 0x40200000 0x0 0x100000>,
			<0x02000000 0x0 0x40300000 0x40300000 0x0 0x1d00000>;

		interrupt-parent = <&pcie0>;
		interrupts = <0 1 2 3 4 5>;
		#interrupt-cells = <1>;
		interrupt-map-mask = <0 0 0 0xffffffff>;
		interrupt-map = <0 0 0 1 &intc GIC_SPI 141 IRQ_TYPE_LEVEL_HIGH
				0 0 0 2 &intc GIC_SPI 142 IRQ_TYPE_LEVEL_HIGH
				0 0 0 3 &intc GIC_SPI 143 IRQ_TYPE_LEVEL_HIGH
				0 0 0 4 &intc GIC_SPI 144 IRQ_TYPE_LEVEL_HIGH
				0 0 0 5 &intc GIC_SPI 140 IRQ_TYPE_LEVEL_HIGH>;

		interrupt-names = "int_a", "int_b", "int_c", "int_d",
					 "int_global_int";

		qcom,pcie-phy-ver = <0x2111>;

		qcom,phy-sequence = <0x0840 0x03 0x0
				0x0094 0x08 0x0
				0x0154 0x35 0x0
				0x0058 0x0f 0x0
				0x00a4 0x42 0x0
				0x0110 0x24 0x0
				0x01bc 0x11 0x0
				0x00bc 0x82 0x0
				0x00d4 0x03 0x0
				0x00d0 0x55 0x0
				0x00cc 0x55 0x0
				0x00b0 0x1a 0x0
				0x00ac 0x0a 0x0
				0x0158 0x01 0x0
				0x0074 0x06 0x0
				0x007c 0x16 0x0
				0x0084 0x36 0x0
				0x01b0 0x1e 0x0
				0x01ac 0xb9 0x0
				0x0010 0x00 0x0
				0x001c 0x31 0x0
				0x0020 0x01 0x0
				0x0024 0xde 0x0
				0x0028 0x07 0x0
				0x0050 0x07 0x0
				0x029c 0x12 0x0
				0x0284 0x05 0x0
				0x051c 0x03 0x0
				0x0518 0x1c 0x0
				0x0524 0x14 0x0
				0x04ec 0x0e 0x0
				0x04f0 0x4a 0x0
				0x04f4 0x0f 0x0
				0x05b4 0x04 0x0
				0x0434 0x7f 0x0
				0x0444 0x70 0x0
				0x0510 0x17 0x0
				0x04d8 0x01 0x0
				0x0598 0xd4 0x0
				0x059c 0x54 0x0
				0x05a0 0xdb 0x0
				0x05a4 0xb9 0x0
				0x05a8 0x31 0x0
				0x0584 0x24 0x0
				0x0588 0xe4 0x0
				0x058c 0xec 0x0
				0x0590 0xb9 0x0
				0x0594 0x36 0x0
				0x0570 0xef 0x0
				0x0574 0xef 0x0
				0x0578 0x2f 0x0
				0x057c 0xd3 0x0
				0x0580 0x40 0x0
				0x04fc 0x00 0x0
				0x04f8 0xc0 0x0
				0x0414 0x04 0x0
				0x09a4 0x01 0x0
				0x0c90 0x00 0x0
				0x0c40 0x01 0x0
				0x0c48 0x01 0x0
				0x0048 0x90 0x0
				0x0c1c 0xc1 0x0
				0x0988 0x66 0x0
				0x0998 0x08 0x0
				0x08dc 0x0d 0x0
				0x09ec 0x01 0x0
				0x0800 0x00 0x0
				0x0844 0x03 0x0>;

		pinctrl-names = "default";
		pinctrl-0 = <&pcie0_clkreq_default
			&pcie0_perst_default
			&pcie0_wake_default>;

		perst-gpio = <&tlmm 57 0>;
		wake-gpio = <&tlmm 53 0>;

		gdsc-vdd-supply = <&gdsc_pcie>;
		vreg-1p8-supply = <&pmxpoorwills_l1>;
		vreg-0p9-supply = <&pmxpoorwills_l4>;
		vreg-cx-supply = <&pmxpoorwills_s5_level>;

		qcom,vreg-1p8-voltage-level = <1200000 1200000 24000>;
		qcom,vreg-0p9-voltage-level = <872000 872000 24000>;
		qcom,vreg-cx-voltage-level = <RPMH_REGULATOR_LEVEL_MAX
						RPMH_REGULATOR_LEVEL_SVS 0>;

		qcom,bw-scale = /* Gen1 */
				<RPMH_REGULATOR_LEVEL_LOW_SVS
				RPMH_REGULATOR_LEVEL_LOW_SVS
				19200000
				/* Gen2 */
				RPMH_REGULATOR_LEVEL_LOW_SVS
				RPMH_REGULATOR_LEVEL_LOW_SVS
				19200000>;

		qcom,aux-clk-sync;

		qcom,ep-latency = <10>;

		qcom,slv-addr-space-size = <0x40000000>;

		qcom,phy-status-offset = <0x814>;

		qcom,cpl-timeout = <0x2>;

		qcom,smmu-sid-base = <0x00A0>;

		qcom,legacy-bdf-2-sid;

		iommu-map = <0x0 &apps_smmu 0x00A0 0x1>,
			<0x100 &apps_smmu 0x00A1 0x1>,
			<0x200 &apps_smmu 0x00A2 0x1>,
			<0x300 &apps_smmu 0x00A3 0x1>,
			<0x400 &apps_smmu 0x00A4 0x1>,
			<0x500 &apps_smmu 0x00A5 0x1>,
			<0x600 &apps_smmu 0x00A6 0x1>,
			<0x700 &apps_smmu 0x00A7 0x1>,
			<0x800 &apps_smmu 0x00A8 0x1>,
			<0x900 &apps_smmu 0x00A9 0x1>,
			<0xa00 &apps_smmu 0x00AA 0x1>,
			<0xb00 &apps_smmu 0x00AB 0x1>,
			<0xc00 &apps_smmu 0x00AC 0x1>,
			<0xd00 &apps_smmu 0x00AD 0x1>,
			<0xe00 &apps_smmu 0x00AE 0x1>,
			<0xf00 &apps_smmu 0x00AF 0x1>;


		msi-parent = <&pcie0_msi>;

		qcom,boot-option = <0x0>;

		linux,pci-domain = <0>;

		qcom,aux-clk-freq = <20>;

		interconnect-names = "icc_path";
		interconnects = <&system_noc MASTER_PCIE_0 &mc_virt SLAVE_EBI1>;

		clocks = <&gcc GCC_PCIE_PIPE_CLK>,
			<&rpmhcc RPMH_CXO_CLK>,
			<&gcc GCC_PCIE_AUX_CLK>,
			<&gcc GCC_PCIE_CFG_AHB_CLK>,
			<&gcc GCC_PCIE_MSTR_AXI_CLK>,
			<&gcc GCC_PCIE_SLV_AXI_CLK>,
			<&gcc GCC_PCIE_0_CLKREF_CLK>,
			<&gcc GCC_PCIE_SLV_Q2A_AXI_CLK>,
			<&gcc GCC_PCIE_SLEEP_CLK>,
			<&gcc GCC_PCIE_PHY_REFGEN_CLK>;

		clock-names = "pcie_0_pipe_clk", "pcie_0_ref_clk_src",
				"pcie_0_aux_clk", "pcie_0_cfg_ahb_clk",
				"pcie_0_mstr_axi_clk", "pcie_0_slv_axi_clk",
				"pcie_0_ldo", "pcie_0_slv_q2a_axi_clk",
				"pcie_0_sleep_clk", "pcie_phy_refgen_clk";

		max-clock-frequency-hz = <0>, <0>, <0>, <19200000>, <0>, <0>, <0>,
					<0>, <0>, <0>, <0>, <100000000>;

		resets = <&gcc GCC_PCIE_BCR>,
			<&gcc GCC_PCIE_PHY_BCR>;

		reset-names = "pcie_0_core_reset",
				"pcie_0_phy_reset";

		pcie_rc0: pcie_rc0 {
			reg = <0 0 0 0 0>;
			pci-ids = "17cb:0307";
		};
	};

	pcie0_msi: qcom,pcie0_msi@a0000000 {
		compatible = "qcom,pci-msi";
		msi-controller;
		reg = <0xa0000000 0x0>;
		interrupt-parent = <&intc>;
		interrupts = <GIC_SPI 257 IRQ_TYPE_LEVEL_HIGH>,
				<GIC_SPI 258 IRQ_TYPE_LEVEL_HIGH>;
		qcom,snps;
	};
};

