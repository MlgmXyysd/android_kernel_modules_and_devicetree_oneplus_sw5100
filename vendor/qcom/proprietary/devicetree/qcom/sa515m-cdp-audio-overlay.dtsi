#include "sa515m-audio-overlay.dtsi"

&soc {
	sound-tavil {
		qcom,wsa-max-devs = <1>;
		qcom,wsa-devs = <&wsa881x_0214>;
		qcom,wsa-aux-dev-prefix = "SpkrRight";
	};
};

&wsa_spkr_wcd_sd2 {
	pinctrl-0 = <&spkr_1_wcd_en_active>;
	pinctrl-1 = <&spkr_1_wcd_en_sleep>;
};
