&hab {
	vmid = <6>;
	/delete-node/ mmidgrp100;
	/delete-node/ mmidgrp200;
	/delete-node/ mmidgrp300;
	/delete-node/ mmidgrp400;
	/delete-node/ mmidgrp500;
	/delete-node/ mmidgrp800;
	/delete-node/ mmidgrp1000;
	/delete-node/ mmidgrp1100;
	/delete-node/ mmidgrp1200;
	/delete-node/ mmidgrp1300;
	/delete-node/ mmidgrp1500;
};

&reserved_memory {
	pmem_shared: pmem_shared_region {
		reg = <0x1 0x66500000 0x0 0x200000>;
		label = "pmem_shared_mem";
	};
};
