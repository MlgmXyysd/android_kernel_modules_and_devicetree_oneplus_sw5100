//From: qcom/monaco-standalone-idp-v1-overlay.dts
/dts-v1/;
/plugin/;

#include "monaco-oplus-x23912.dtsi"

/ {
	model = "Qualcomm Technologies, Inc. Monaco Watch V4B01 overlay";
	qcom,board-id = <0x010022 0x1>;
	oplus,project-id = <23912>;
	oplus,hw-id = <0x02 0x00000000 0xffffffff>;
};
