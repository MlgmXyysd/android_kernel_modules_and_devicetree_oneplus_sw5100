/*
 * Copyright (c) 2015, The Linux Foundation. All rights reserved.
 *
 * This program is free software; you can redistribute it and/or modify
 * it under the terms of the GNU General Public License version 2 and
 * only version 2 as published by the Free Software Foundation.
 *
 * This program is distributed in the hope that it will be useful,
 * but WITHOUT ANY WARRANTY; without even the implied warranty of
 * MERCHANTABILITY or FITNESS FOR A PARTICULAR PURPOSE.  See the
 * GNU General Public License for more details.
 */

qcom,nvt_opowx64_350mah {
	qcom,battery-type = "NVT-OPOWX64-350mah";
	qcom,nom-batt-capacity-mah = <360>;
	qcom,batt-id-kohm = <106>;
	qcom,battery-beta = <3440>;
	qcom,battery-thermal-coefficients = [a1 50 ff];
	qcom,default-rbatt-mohm = <180>;
	qcom,max-voltage-uv = <4430000>;
	qcom,fastchg-current-ma = <625>;
	qcom,fg-cc-cv-threshold-mv = <4430>;

	qcom,checksum = <0x5A8E>;
	qcom,gui-version = "PM660GUI - 0.0.0.45";
	qcom,fg-profile-data = [
		 D0 23 75 0C
		 07 13 75 0D
		 F9 1C D3 FA
		 0D FC B0 02
		 20 18 00 23
		 AB 45 7D 52
		 9A 00 00 00
		 14 00 00 00
		 00 00 F7 CD
		 44 BC 6C CA
		 41 00 08 00
		 8F F2 16 07
		 05 ED 53 E5
		 89 EA 90 02
		 86 0D E9 4A
		 10 06 09 20
		 27 00 14 00
		 4B 20 A0 04
		 A2 0B EE 04
		 C8 1C ED 02
		 19 0C 3D 12
		 89 18 19 23
		 4F 45 42 53
		 6B 00 00 00
		 11 00 00 00
		 00 00 4E CC
		 E5 C2 27 B2
		 40 00 00 00
		 61 FA 16 07
		 81 EC 4E E5
		 13 E2 33 01
		 87 05 24 1A
		 9F 33 CC FF
		 07 10 00 00
		 75 01 33 47
		 40 00 40 00
		 59 03 0A FA
		 FF 00 00 00
		 00 00 00 00
		 00 00 00 00
		 00 00 00 00
		 00 00 00 00
		 00 00 00 00
		 00 00 00 00
		 00 00 00 00
		 00 00 00 00
		 00 00 00 00
		 00 00 00 00
		 00 00 00 00
		 00 00 00 00
		 00 00 00 00
		 00 00 00 00
		 00 00 00 00
		 00 00 00 00
		 00 00 00 00
		 00 00 00 00
	];
};
