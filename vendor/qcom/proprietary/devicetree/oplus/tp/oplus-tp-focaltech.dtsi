&qupv3_se1_i2c {

	focaltech@38{
		compatible = "focaltech,fts";
		reg = <0x38>;
		interrupt-parent = <&tlmm>;
		interrupts = <13 0x02>;
		//vdd-supply = <&pm8916_l15>;
		//vcc_i2c-supply = <&pm8916_l16>;
		focaltech,reset-gpio = <&tlmm 12 0x01>;
		focaltech,irq-gpio = <&tlmm 13 0x02>;
		focaltech,max-touch-number = <10>;
		focaltech,display-coords = <0 0 377 495>;

		pinctrl-names = "pmx_ts_active","pmx_ts_suspend","pmx_ts_release";
		pinctrl-0 = <&ts_int_active &ts_reset_active>;
		pinctrl-1 = <&ts_int_suspend &ts_reset_suspend>;
		pinctrl-2 = <&ts_release>;

		/*
		focaltech,have-key;
		focaltech,key-number = <3>;
		focaltech,keys = <139 102 158>;
		focaltech,key-x-coords = <200 600 800>;
		focaltech,key-y-coords = <2000 2000 2000>;
		*/
	};

};

