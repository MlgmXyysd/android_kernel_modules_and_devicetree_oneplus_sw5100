&qupv3_se1_i2c {
	bt541_ts_device@20 {
		compatible = "zinitix,bt541_ts_device";
		reg = <0x20>;
		interrupt-parent = <&tlmm>;
		interrupts = <13 0x2008>;
		vdd-supply = <&tp_vdd_3v0>;
		vcc_i2c-supply = <&tp_vdd_1v8>;
		bus_pull-supply = <&L21A>;

		/* pins used by touchscreen */
		pinctrl-names = "pmx_ts_active", "pmx_ts_suspend",
				"pmx_ts_release";
		pinctrl-0 = <&ts_int_active &ts_reset_active>;
		pinctrl-1 = <&ts_int_suspend &ts_reset_suspend>;
		pinctrl-2 = <&ts_release>;

		zinitix,irq-gpio = <&tlmm 13 0x2008>;
		zinitix,reset-gpio = <&tlmm 12 0x00>;
		zinitix,x_resolution = <466>;
		zinitix,y_resolution = <466>;
		zinitix,page_size = <128>;
		zinitix,orientation = <0>;
		zinitix,tsp_vdd_supply_type = <1>;
		zinitix,pname = "SM-G5308W";
	};
};

